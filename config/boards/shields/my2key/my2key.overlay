/ {
    chosen {
        zmk,kscan = &kscan0;
    };

    kscan0: kscan0 {
        compatible = "zmk,kscan-gpio-direct";
        wakeup-source;
        input-gpios
            = <&pro_micro 7 (GPIO_ACTIVE_LOW | GPIO_PULL_UP)>
            , <&pro_micro 8 (GPIO_ACTIVE_LOW | GPIO_PULL_UP)>
            ;
    };
};
